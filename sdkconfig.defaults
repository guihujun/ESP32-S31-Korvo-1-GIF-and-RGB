## sdkconfig.defaults
```kconfig
# ============================================================
# ESP32-S31-Korvo GIF 动图 + RGB 灯控制示例 默认配置
# ============================================================

# ----- 目标芯片 -----
CONFIG_IDF_TARGET="esp32s31"

# ----- Flash 配置 -----
CONFIG_ESPTOOLPY_FLASHMODE_QIO=y
CONFIG_ESPTOOLPY_FLASHSIZE_8MB=y
CONFIG_PARTITION_TABLE_CUSTOM=y
CONFIG_PARTITION_TABLE_CUSTOM_FILENAME="partitions.csv"

# ----- PSRAM 配置（8MB Octal PSRAM，与官方 factory_demo 一致） -----
CONFIG_SPIRAM=y
CONFIG_SPIRAM_SPEED_250M=y
CONFIG_SPIRAM_XIP_FROM_PSRAM=y
CONFIG_SPIRAM_MEMTEST=n
CONFIG_SPIRAM_MALLOC_RESERVE_INTERNAL=12768
CONFIG_SPIRAM_ALLOW_BSS_SEG_EXTERNAL_MEMORY=y
CONFIG_SPIRAM_ALLOW_NOINIT_SEG_EXTERNAL_MEMORY=y

# ----- FreeRTOS -----
CONFIG_FREERTOS_HZ=1000

# ----- LVGL 配置（LVGL v9.6.0） -----
# 关键选项：启用 GIF 动图组件（lv_gif）
CONFIG_LV_USE_GIF=y
# 让 LVGL 内部分配走系统 malloc（自动路由大块内存到 PSRAM）
CONFIG_LV_USE_CLIB_MALLOC=y
CONFIG_LV_USE_CLIB_STRING=y
CONFIG_LV_USE_CLIB_SPRINTF=y
CONFIG_LV_DEF_REFR_PERIOD=15
CONFIG_LV_DPI_DEF=60
CONFIG_LV_DRAW_LAYER_SIMPLE_BUF_SIZE=29152
# LVGL 图像缓存 4MB（分配在 PSRAM，与官方 factory_demo 一致）
CONFIG_LV_CACHE_DEF_SIZE=4194304
CONFIG_LV_IMAGE_HEADER_CACHE_DEF_CNT=32
```
